## conf/layer.conf
```bitbake
# We have a conf and classes directory, add to BBPATH
BBPATH := "${LAYERDIR}:${BBPATH}"

LAYER_PATH_hac := "${LAYERDIR}"


# We have a packages directory, add to BBFILES
BBFILES := "${BBFILES} ${LAYERDIR}/recipes-*/*/*.bb \
            ${LAYERDIR}/recipes-*/*/*.bbappend"

BBFILE_COLLECTIONS += "hac"
BBFILE_PATTERN_hac := "^${LAYERDIR}/"
BBFILE_PRIORITY_hac = "7"
BB_NO_NETWORK = "0"

# Add scripts to PATH
PATH := "${PATH}:${LAYERDIR}/scripts"

# We have a pre-populated downloads directory, add to PREMIRRORS
PREMIRRORS_append := "\
     git://.*/.* file://${LAYERDIR}/downloads/ \n \
     svn://.*/.* file://${LAYERDIR}/downloads/ \n \
     ftp://.*/.* file://${LAYERDIR}/downloads/ \n \
     http://.*/.* file://${LAYERDIR}/downloads/ \n \
     https://.*/.* file://${LAYERDIR}/downloads/ \n"

# This should only be incremented on significant changes that will
# cause compatibility issues with other layers
LAYERVERSION_hac = "1"
```
